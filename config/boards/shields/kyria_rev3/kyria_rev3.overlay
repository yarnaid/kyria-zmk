/ {
    chosen {
        zmk,backlight = &backlight;
    };

    backlight: pwmleds {
        compatible = "pwm-leds";
        label = "Backlight LEDs";
        pwm-names = "backlight";
        pwm = <&pwm0>;
    };
};

&pwm0 {
    status = "okay";
    ch0-pin = <45>;
    /* ch0-inverted; */
};